## src/modules/fw_autotune_attitude_control/Kconfig
```kconfig
menuconfig MODULES_FW_AUTOTUNE_ATTITUDE_CONTROL
	bool "fw_autotune_attitude_control"
	depends on n
	default n
	---help---
		Enable support for fw_autotune_attitude_control
```

## src/modules/motion_detector/Kconfig
```kconfig
menuconfig MODULES_MOTION_DETECTOR
	bool "motion_detector"
	default n
	---help---
		Enable support for motion_detector

menuconfig USER_MOTION_DETECTOR
	bool "motion_detector running as userspace module"
	default n
	depends on BOARD_PROTECTED && MODULES_MOTION_DETECTOR
	---help---
		Put motion_detector in userspace memory
```
